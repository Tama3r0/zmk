/* キーボードのキーマップを記述する */ 
#include <dt-bindings/zmk/keys.h>
#include <dt-bindings/zmk/bt.h>

/{
  chosen {
      zmk, kscan = &kscan0;
;}
keymap {
  compatible = "zmk, keymap";

  default_layer {
    bindings = <
&kp Q &kp W &kp E &kp R &kp T
&kp A &kp S &kp D &kp F &kp G
&kp Z &kp X &kp C &kp V &kp B
      >;
  };
};
};  
